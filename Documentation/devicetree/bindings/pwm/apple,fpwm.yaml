## Documentation/devicetree/bindings/pwm/apple,fpwm.yaml
```yaml
# SPDX-License-Identifier: GPL-2.0-only OR BSD-2-Clause
%YAML 1.2
---
$id: http://devicetree.org/schemas/pwm/apple,fpwm.yaml#
$schema: http://devicetree.org/meta-schemas/core.yaml#

title: Apple M1 FPWM controller

maintainers:
  - Pip Cet <pipcet@gmail.com>

description:
  Single-channel PWM connected to the keyboard backlight on at least
  some MacBook Pros.

allOf:
  - $ref: pwm.yaml#

properties:
  compatible:
    const: apple,t8103-fpwm

  reg:
    maxItems: 1

  clocks:
    maxItems: 1

  "#pwm-cells":
    const: 0

additionalProperties: false

required:
  - reg
  - clocks

examples:
  - |
    pwm@235044000 {
        compatible = "apple,t8103-fpwm";
        reg = <0x35044000 0x4000>;
        clocks = <&fpwm0_clk>;
        #pwm-cells = <0>;
    };
```

## Documentation/devicetree/bindings/watchdog/apple,wdt.yaml
```yaml
# SPDX-License-Identifier: (GPL-2.0-only OR BSD-2-Clause)
%YAML 1.2
---
$id: http://devicetree.org/schemas/watchdog/apple,wdt.yaml#
$schema: http://devicetree.org/meta-schemas/core.yaml#

title: Apple M1 Watchdog Timer Device Tree Bindings

maintainers:
  - Pip Cet <pipcet@gmail.com>

allOf:
  - $ref: watchdog.yaml#

properties:
  compatible:
    enum:
      - apple,t8103-wdt

  reg:
    maxItems: 1

  clocks:
    maxItems: 1

required:
  - compatible
  - clocks
  - reg

additionalProperties: false

examples:
  - |
    watchdog@3bd20000 {
        compatible = "apple,t8103-wdt";
        reg = <0x3bd20000 0x4000>;
        clocks = <&clk24>;
    };
```
